## components/sdcard/Kconfig
```kconfig
menu "SD Card Configuration"

config I2C_MASTER_SDA
    int "I2C SDA GPIO"
    default 8

config I2C_MASTER_SCL
    int "I2C SCL GPIO"
    default 9

config EXAMPLE_PIN_MOSI
    int "SD SPI MOSI GPIO"
    default 11

config EXAMPLE_PIN_MISO
    int "SD SPI MISO GPIO"
    default 13

config EXAMPLE_PIN_CLK
    int "SD SPI CLK GPIO"
    default 12

config EXAMPLE_PIN_CS
    int "SD SPI CS GPIO"
    default -1

endmenu
```
